## package/dpdk/Config.in
```kconfig
config BR2_PACKAGE_DPDK
	bool "dpdk"
	depends on BR2_PACKAGE_LIBBSD_ARCH_SUPPORTS # libbsd
	depends on !BR2_STATIC_LIBS # libbsd
	depends on BR2_TOOLCHAIN_HAS_THREADS # libbsd
	depends on BR2_USE_WCHAR # libbsd, libexecinfo
	select BR2_PACKAGE_LIBBSD
	select BR2_PACKAGE_LIBEXECINFO if !BR2_TOOLCHAIN_USES_GLIBC
	select BR2_PACKAGE_JANSSON
	select BR2_PACKAGE_LIBPCAP
	select BR2_PACKAGE_ZLIB
	help
	  DPDK (Data Plane Development Kit) is a set of libraries
	  and drivers for fast packet processing.

	  http://dpdk.org/

comment "dpdk needs a toolchain w/ dynamic library, threads, wchar"
	depends on BR2_PACKAGE_LIBBSD_ARCH_SUPPORTS
	depends on BR2_STATIC_LIBS || !BR2_TOOLCHAIN_HAS_THREADS || !BR2_USE_WCHAR
```
